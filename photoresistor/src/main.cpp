#include <Arduino.h>

const int LDR_PIN = A0;   // Пин фоторезистора
const int LED_PIN = 13;   // Пин светодиода-ночника

// Пороговые значения освещенности (от 0 до 1023)
// Настраиваются индивидуально под вашу комнату!
//const int DARK_THRESHOLD = 300;  // Порог включения (стало темно) Данное значение мало (проверенно опытным путем)
//const int LIGHT_THRESHOLD = 400; // Порог выключения (стало светло) Данное значение мало (проверенно опытным путем)

// Учитываем, что при ладони значение падает до ~491, а на свету держится ~818
const int DARK_THRESHOLD = 550;  // Включаем свет, если значение упало ниже 550 (2.7 Вольта)
const int LIGHT_THRESHOLD = 700; // Выключаем свет, если значение поднялось выше 700 (3.4 Вольта)

bool isLightOn = false;   // Текущее состояние ночника

void setup() {
  pinMode(LED_PIN, OUTPUT);
  Serial.begin(9600); // Включаем монитор порта для калибровки датчика
}

void loop() {
  // Считываем значение с фоторезистора (0 - максимум темноты, 1023 - максимум света)
  int lightLevel = analogRead(LDR_PIN);
  
  // Выводим данные в Serial, чтобы видеть реальную освещенность комнаты
  Serial.print("Текущий уровень света: ");
  Serial.println(lightLevel);

  // Логика управления с гистерезисом (двумя порогами)
  if (lightLevel < DARK_THRESHOLD) {
    isLightOn = true;  // Если свет упал ниже порога темноты -> включаем ночник
  } 
  else if (lightLevel > LIGHT_THRESHOLD) {
    isLightOn = false; // Если свет поднялся выше порога светлости -> выключаем
  }

  // Физически управляем светодиодом на основе флага
  if (isLightOn) {
    digitalWrite(LED_PIN, HIGH);
  } else {
    digitalWrite(LED_PIN, LOW);
  }

  delay(100); // Небольшая задержка, чтобы не спамить в Serial порт
}